## drivers/dart-staging/Kconfig
```kconfig
menuconfig DART_STAGING
	bool "Dart Kernel Community Modules (Read my help FIRST)"
	help
          If you want to enable Community Modules, say Y.

	  To contribute a driver, ask into the Discord server or
	  make a pull request and wait to be accepted.

	  Note: Make sure you modify my Kconfig at drivers/dart-staging and
	  include your Kconfig!

	  === Tag Glossary ===
	   Problematic:        Driver is messed up and not fully tested yet (not recommended selecting)
	   Deprecated:         Driver will be going to be removed the next few commits (good fricking luck)

	  Kconfig by Saverio Karol Bizzoco (@sasyyy112)

if DART_STAGING
# Include your Kconfig here
# e.g.  source "drivers/dart-staging/foo/Kconfig"

comment "Last Commit Date: 2025/08/24, Drivers: 0"

endif # DART_STAGING
```

## drivers/video/logo/Kconfig
```kconfig
# SPDX-License-Identifier: GPL-2.0-only
#
# Logo configuration
#

menuconfig LOGO
	bool "Bootup logo (Dart patch)"
	depends on FB_CORE || SGI_NEWPORT_CONSOLE
	help
	  Enable and select frame buffer bootup logos.
	  Monochrome logos will also be used by the DRM panic handler, if
	  enabled.

if LOGO

config FB_LOGO_EXTRA
	bool
	depends on FB=y
	default y if SPU_BASE

config LOGO_DART_MONO
	bool "Standard black and white Dart Linux logo"
	default y

config LOGO_DART_VGA16
	bool "Standard 16-color Dart Linux logo"
	default y

config LOGO_DART_CLUT224
	bool "Standard 224-color Dart Linux logo"
	default y

config LOGO_DEC_CLUT224
	bool "224-color Digital Equipment Corporation Classic Tux"
	depends on MACH_DECSTATION || ALPHA
	default y

config LOGO_MAC_CLUT224
	bool "224-color Macintosh Classic Tux"
	depends on MAC
	default y

config LOGO_PARISC_CLUT224
	bool "224-color PA-RISC Classic Tux"
	depends on PARISC
	default y

config LOGO_SGI_CLUT224
	bool "224-color SGI Classic Tux"
	depends on SGI_IP22 || SGI_IP27 || SGI_IP32
	default y

config LOGO_SUN_CLUT224
	bool "224-color Sun Classic Tux"
	depends on SPARC
	default y

config LOGO_SUPERH_MONO
	bool "Black and white SuperH Logo"
	depends on SUPERH
	default y

config LOGO_SUPERH_VGA16
	bool "16-color SuperH Classic Tux"
	depends on SUPERH
	default y

config LOGO_SUPERH_CLUT224
	bool "224-color SuperH Classic Tux"
	depends on SUPERH
	default y

endif # LOGO
```
